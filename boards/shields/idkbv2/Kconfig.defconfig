## boards/shields/idkbv2/Kconfig.defconfig
```kconfig
if SHIELD_IDKBV2_RIGHT

config ZMK_KEYBOARD_NAME
    default "idkbv2"

endif

if SHIELD_IDKBV2_LEFT || SHIELD_IDKBV2_RIGHT

config ZMK_SPLIT
    default y

endif
```

## boards/shields/idkbv2/Kconfig.shield
```kconfig
config SHIELD_IDKBV2_LEFT
    def_bool $(shields_list_contains,idkbv2_left)
config SHIELD_IDKBV2_RIGHT
    def_bool $(shields_list_contains,idkbv2_right)
```

## config/west.yml
```yaml
manifest:
  remotes:
    - name: zmkfirmware
      url-base: https://github.com/zmkfirmware
    - name: sekigon-gonnoc
      url-base: https://github.com/sekigon-gonnoc
    - name: badjeff
      url-base: https://github.com/badjeff
  projects:
    - name: zmk
      remote: zmkfirmware
      revision: main
      import: app/west.yml
    # ▼ 必須: トラックボールを動かすためのドライバー
    - name: zmk-driver-paw3222
      remote: sekigon-gonnoc
      revision: main
    # ▼ 必須: スクロール機能を実現するためのモジュール
    - name: zmk-input-behavior-listener
      remote: badjeff
      revision: main
  self:
    path: config
```
